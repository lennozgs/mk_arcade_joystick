## Config.in
```kconfig
config BR2_PACKAGE_MK_ARCADE_JOYSTICK_XU4
	bool "mk_arcade_joystick_xu4 GPIO Kernel Module"
	depends on BR2_LINUX_KERNEL
	help
	  Kernel module to support joystick on xu4 gpios

comment "mk_arcade_joystick_xu4 needs a kernel and headers"
	depends on !BR2_LINUX_KERNEL
```
